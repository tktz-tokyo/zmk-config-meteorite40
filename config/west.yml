## config/west.yml
```yaml
manifest:
  remotes:
    - name: zmkfirmware
      url-base: https://github.com/zmkfirmware
    - name: tktz-tokyo
      url-base: https://github.com/tktz-tokyo
    - name: eswai # ここを追加
      url-base: https://github.com/eswai
  projects:
    - name: zmk
      remote: zmkfirmware
      revision: main
      import: app/west.yml
    - name: zmk-pmw3610-driver
      remote: iwk7273
      revision: main
    - name: zmk-feature-sensor_rotation
      remote: iwk7273
      revision: main
    - name: zmk-feature-xy_clipper
      remote: iwk7273
      revision: main
    - name: zmk-feature-scaling
      remote: iwk7273
      revision: main
    - name: zmk-smart-toggle
      remote: iwk7273
      revision: main
    - name: zmk-feature-meteorite-config
      remote: iwk7273
      revision: main
    - name: zmk-naginata # ここを追加
      remote: eswai
      revision: main
  self:
    path: config
```
